## config/boards/shields/iqs5xx_dev/Kconfig.defconfig
```kconfig
config ZMK_KEYBOARD_NAME
    default "IQS5xxDev"

config ZMK_POINTING
    default y

config I2C
    default y
```

## config/west.yml
```yaml
manifest:
  remotes:
  - name: zmkfirmware
    url-base: https://github.com/zmkfirmware
  - name: danielnordqvist
    url-base: https://github.com/danielnordqvist
  projects:
  - name: zmk
    remote: zmkfirmware
    revision: main
    import: app/west.yml
  - name: zmk-driver-azoteq-iqs5xx
    remote: danielnordqvist
    revision: main
```
